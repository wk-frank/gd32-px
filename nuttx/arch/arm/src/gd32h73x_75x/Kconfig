## nuttx/arch/arm/src/gd32h73x_75x/Kconfig
```kconfig
# GD32H73x/75x NuttX Kconfig 骨架（对齐 GD32-MCU-IOT/gd32_nuttx 目录规范）
# 状态：M1 骨架，待合入 PX4 platforms/nuttx/NuttX 后由 kconfig-mconf 验证

if ARCH_CHIP_GD32H73X_75X

choice
	prompt "GD32H73x/75x Chip Selection"
	default ARCH_CHIP_GD32H757ZM

config ARCH_CHIP_GD32H757ZM
	bool "GD32H757ZMT6 (Cortex-M7, 600MHz, 3840KB Flash, 1024KB SRAM, LQFP144)"
	select GD32H7_HAVE_CANFD
	select ARCH_HAVE_FPU
	select ARCH_HAVE_DPFPU
	select ARCH_HAVE_ICACHE
	select ARCH_HAVE_DCACHE
	select ARCH_HAVE_MPU

endchoice

config GD32H7_FLASH_SIZE_KB
	int "On-chip Flash size (KB)"
	default 3840 if ARCH_CHIP_GD32H757ZM

config GD32H7_SRAM_TOTAL_KB
	int "On-chip SRAM total size (KB)"
	default 1024 if ARCH_CHIP_GD32H757ZM

config GD32H7_SYSCLK_MAX_MHZ
	int "Maximum CPU clock frequency (MHz)"
	default 600

config GD32H7_HAVE_CANFD
	bool
	default n

endif # ARCH_CHIP_GD32H73X_75X
```

## nuttx/boards/arm/gd32h73x_75x/gd32h757-fc-v1/configs/nsh/defconfig
```kconfig
#
# NuttX defconfig for gd32_h757-fc-v1 (M1 NSH 最小启动 + M2/M3 外设使能基线)
# 对齐 PX4 v1.17.0 NuttX 子模块风格
#
CONFIG_ARCH="arm"
CONFIG_ARCH_ARM=y
CONFIG_ARCH_CHIP="gd32h73x_75x"
CONFIG_ARCH_CHIP_GD32H73X_75X=y
CONFIG_ARCH_CHIP_GD32H757ZM=y
CONFIG_ARCH_CORTEXM7=y
CONFIG_ARCH_FPU=y
CONFIG_ARCH_DPFPU=y
CONFIG_ARCH_ICACHE=y
CONFIG_ARCH_DCACHE=y
CONFIG_ARM_MPU=y
CONFIG_ARCH_BOARD="gd32h757-fc-v1"
CONFIG_ARCH_BOARD_CUSTOM=y

CONFIG_RAM_SIZE=524288
CONFIG_RAM_START=0x24000000
CONFIG_MM_REGIONS=2

CONFIG_USEC_PER_TICK=1000
CONFIG_HIGH_RESOLUTION_TIMERS=y
CONFIG_SCHED_WORKQUEUE=y
CONFIG_SCHED_HPWORK=y
CONFIG_SCHED_LPWORK=y

CONFIG_USART0_SERIAL_CONSOLE=y
CONFIG_USART0_BAUD=115200
CONFIG_USART0_BITS=8
CONFIG_USART0_PARITY=0
CONFIG_USART0_2STOP=0

CONFIG_SPI=y
CONFIG_SPI_EXCHANGE=y
CONFIG_I2C=y
CONFIG_RTC=y
CONFIG_WATCHDOG=y

CONFIG_NSH_LIBRARY=y
CONFIG_SYSTEM_NSH=y
CONFIG_NSH_CONSOLE=y
CONFIG_EXAMPLES_HELLO=y
```
